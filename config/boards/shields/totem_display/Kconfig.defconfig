## config/boards/shields/totem_display/Kconfig.defconfig
```kconfig
# Copyright (c) 2024 The ZMK Contributors
# SPDX-License-Identifier: MIT

if SHIELD_TOTEM_DISPLAY

choice ZMK_DISPLAY_STATUS_SCREEN
    default ZMK_DISPLAY_STATUS_SCREEN_CUSTOM
endchoice

config ZMK_DISPLAY_STATUS_SCREEN_CUSTOM
    select LV_USE_LABEL
    select LV_USE_IMG
    select LV_USE_CANVAS
    select LV_USE_ANIMIMG 
    select LV_USE_ANIMATION
    select LV_USE_LINE 
    select LV_FONT_UNSCII_8
    select ZMK_WPM
    imply ZMK_HID_INDICATORS

config ZMK_TOTEM_DISPLAY_SCREEN
    bool "Draw the dongle screen as one picture instead of a stack of widgets"
    default y
    select LV_FONT_MONTSERRAT_20
    help
        Replaces every widget on the dongle screen with a single canvas that
        is drawn pixel by pixel: battery gauges in the corners, the layer in
        the middle, one large line of what the keyboard has been sending, and
        a plain-language caption underneath. Turn this off to go back to the
        original widget layout.

config ZMK_TOTEM_DISPLAY_SWAP_BATTERIES
    bool "Swap which corner each half's battery is shown in"
    depends on ZMK_TOTEM_DISPLAY_SCREEN
    help
        The halves are shown left and right in the order they report. Enable
        this if yours arrive the other way round.

config ZMK_TOTEM_DISPLAY_DONGLE_BATTERY
    bool "Show also the battery level of the dongle"
    depends on BT && (!ZMK_SPLIT_BLE || ZMK_SPLIT_ROLE_CENTRAL)

config ZMK_TOTEM_DISPLAY_MAC_MODIFIERS
    bool "Use MacOS modifier symbols instead of the Windows symbols"

config ZMK_TOTEM_DISPLAY_KEYLOG
    bool "Display a log of the keycodes the keyboard actually sends"
    default y
    help
        Shows the last few HID keycodes emitted, newest at the bottom right.
        Because it reports what was sent rather than what was pressed, it
        tells you whether a combo, a home-row mod or a tap-dance resolved
        the way you meant it to, without a host-side event viewer.

config ZMK_TOTEM_DISPLAY_BONGO_CAT
    bool "Display the Bongo Cat widget"
    default n if ZMK_TOTEM_DISPLAY_KEYLOG
    default y

config ZMK_TOTEM_DISPLAY_MODIFIERS
    bool "Display the modifiers widget"
    default y

config ZMK_TOTEM_DISPLAY_LAYER
    bool "Display the highest layer widget"
    default y

config ZMK_TOTEM_DISPLAY_LAYER_NAME_SCROLL_WIDTH
    int "Width for layer name label (in pixels)"
    default 50
    help
        Width in pixels for the layer name label. When the layer name
        exceeds this width, it will scroll horizontally in a circular pattern.

config ZMK_TOTEM_DISPLAY_LAYER_TEXT_ALIGN
    string "Layer name text alignment"
    default "left"
    help
        Text alignment for the layer name label. Valid values: "left", "center", "right".

config ZMK_TOTEM_DISPLAY_WPM
    bool "Display the WPM widget"
    default n

config ZMK_TOTEM_DISPLAY_WPM_DISABLED_LAYERS
    string "Layers in which the widget is disabled, comma separated"
    default ""

choice ZMK_DISPLAY_WORK_QUEUE
    default ZMK_DISPLAY_WORK_QUEUE_DEDICATED
endchoice

config LV_Z_MEM_POOL_SIZE
    default 8192

config LV_Z_VDB_SIZE
    default 64

config LV_DPI_DEF
    default 148

config LV_Z_BITS_PER_PIXEL
    default 1

choice LV_COLOR_DEPTH
    default LV_COLOR_DEPTH_1
endchoice

endif
```

## config/boards/shields/totem_display/Kconfig.shield
```kconfig
# Copyright (c) 2024 The ZMK Contributors
# SPDX-License-Identifier: MIT

config SHIELD_TOTEM_DISPLAY
	def_bool $(shields_list_contains,totem_display)
```

## config/recorder/Kconfig
```kconfig
DT_COMPAT_ZMK_BEHAVIOR_RECORDER_TOGGLE := zmk,behavior-recorder-toggle

config ZMK_RECORDER
        bool "Stream timed key events to the host over a USB serial port"
        depends on USB_CDC_ACM && UART_LINE_CTRL
        help
          Writes one line per raw key press/release, emitted keycode and layer
          change to the serial port chosen as zmk,recorder-uart. Nothing is
          sent until recording is switched on with the toggle behavior, and
          nothing is sent while no program on the host has the port open.

config ZMK_BEHAVIOR_RECORDER_TOGGLE
        bool
        default $(dt_compat_enabled,$(DT_COMPAT_ZMK_BEHAVIOR_RECORDER_TOGGLE))
        depends on ZMK_RECORDER
```

## config/recorder/dts/bindings/behaviors/zmk,behavior-recorder-toggle.yaml
```yaml
description: Switch the key-press recorder on or off

compatible: "zmk,behavior-recorder-toggle"

include: zero_param.yaml
```
